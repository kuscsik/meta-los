## conf/distro/los.conf
```bitbake
# Distribution definition for: Linaro OpenSdk

# from dev manual:
# Your configuration file needs to set the following variables:
#
#      DISTRO_NAME [required]
#      DISTRO_VERSION [required]
#      DISTRO_FEATURES [required if creating from scratch]
#      DISTRO_EXTRA_RDEPENDS [optional]
#      DISTRO_EXTRA_RRECOMMENDS [optional]
#      TCLIBC [required if creating from scratch]

LOCALCONF_VERSION = "1"
LAYER_CONF_VERSION ?= "6"

DISTRO = "los"
DISTRO_NAME = "Linaro OpenSDK (A Yocto Project 2.0 based Distro)"
DISTRO_VERSION = "1.0"
DISTRO_CODENAME = "jetro"
SDK_VENDOR = "-los"
SDK_VERSION := "${@'${DISTRO_VERSION}'.replace('snapshot-${DATE}','snapshot')}"
SDK_NAME = "${DISTRO}-${TCLIBC}-${SDK_ARCH}-${TARGET_ARCH}"
SDKPATH = "/opt/${DISTRO}/${SDK_VERSION}"

PREFERRED_VERSION_mesa = "11.%"

PREFERRED_PROVIDER_virtual/libgles1 ?= "mali450-userland-drm"
PREFERRED_PROVIDER_virtual/libgles2 ?= "mali450-userland-drm"
PREFERRED_PROVIDER_virtual/egl ?= "mali450-userland-drm"

MAINTAINER = "Christophe Priouzeau <christophe.priouzeau@linaro.org>"

# Set rootfs label
ROOTFS_LABEL ?= "system"
EXTRA_IMAGECMD_ext4 += " -L ${ROOTFS_LABEL} "
IMAGE_ROOTFS_ALIGNMENT = "4096"

TARGET_VENDOR = "-los"

SECURITY_IMAGE_INSTALL = "${@base_contains('MACHINE_FEATURES', 'optee', 'kernel-module-optee optee-aes-decryptor kernel-module-optee-armtz optee-os optee-client optee-ta-luc14-helloword', '', d)} "

PACKAGECONFIG_pn-chromium_append = "${@base_contains('MACHINE_FEATURES', 'optee', 'ocdm', '', d)} "


# TODO: is that really want we want?
IMAGE_LINGUAS = "en-gb"

DISTRO_FEATURES = " \
        alsa argp ext2 ext4 largefile usbgadget usbhost \
        ipv4 ipv6 wifi nfs zeroconf \
        xattr \
        ${DISTRO_FEATURES_LIBC}"

DISTRO_FEATURES_append = " opengl multiarch"
# add support of x11
#DISTRO_FEATURES_append += " x11 "

#add support of bluetooth
#DISTRO_FEATURES_append += " bluetooth "

# add support of wayland
DISTRO_FEATURES_append += " wayland pam "
# add support of systemd
DISTRO_FEATURES_append += " systemd "

DISTRO_FEATURES_BACKFILL_CONSIDERED += "sysvinit"
VIRTUAL-RUNTIME_init_manager = "systemd"
VIRTUAL-RUNTIME_initscripts = "systemd-compat-units"

#mirror
PREMIRRORS ??= "\
bzr://.*/.*   http://downloads.yoctoproject.org/mirror/sources/ \n \
cvs://.*/.*   http://downloads.yoctoproject.org/mirror/sources/ \n \
git://.*/.*   http://downloads.yoctoproject.org/mirror/sources/ \n \
gitsm://.*/.* http://downloads.yoctoproject.org/mirror/sources/ \n \
hg://.*/.*    http://downloads.yoctoproject.org/mirror/sources/ \n \
osc://.*/.*   http://downloads.yoctoproject.org/mirror/sources/ \n \
p4://.*/.*    http://downloads.yoctoproject.org/mirror/sources/ \n \
svn://.*/.*   http://downloads.yoctoproject.org/mirror/sources/ \n"

MIRRORS =+ "\
ftp://.*/.*      http://downloads.yoctoproject.org/mirror/sources/ \n \
http://.*/.*     http://downloads.yoctoproject.org/mirror/sources/ \n \
https://.*/.*    http://downloads.yoctoproject.org/mirror/sources/ \n"

# append Linaro mirrors as our last chance to find what we are looking for
MIRRORS =+ "\
git://.*/.*      http://snapshots.linaro.org/openembedded/sources/ \n \
svn://.*/.*      http://snapshots.linaro.org/openembedded/sources/ \n \
bzr://.*/.*      http://snapshots.linaro.org/openembedded/sources/ \n \
ftp://.*/.*      http://snapshots.linaro.org/openembedded/sources/ \n \
http://.*/.*     http://snapshots.linaro.org/openembedded/sources/ \n \
https://.*/.*    http://snapshots.linaro.org/openembedded/sources/ \n"

#for gstreamer libav
LICENSE_FLAGS_WHITELIST += " commercial"

#to test
#GCCVERSION = "4.9%"
#SDKGCCVERSION = "4.9%"
```

## conf/layer.conf
```bitbake
# We have a conf and classes directory, add to BBPATH
BBPATH .= ":${LAYERDIR}"

# We have a packages directory, add to BBFILES
BBFILES += "${LAYERDIR}/recipes-*/*/*.bb \
            ${LAYERDIR}/recipes-*/*/*.bbappend"

BBFILE_COLLECTIONS += "los"
BBFILE_PATTERN_los := "^${LAYERDIR}/"
BBFILE_PRIORITY_los = "5"
```
